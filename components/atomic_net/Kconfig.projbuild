## components/atomic_net/Kconfig.projbuild
```kconfig
menu "atomic_net"

    config A_WIFI_ENABLE_STA
        bool "Compile Wi-Fi Station (STA) support"
        default y
        help
            Compile the STA side of atomic_wifi. With this off, a_wifi_apply_mode(STA)
            returns ESP_ERR_NOT_SUPPORTED and AP becomes the only available mode.

    config A_WIFI_ENABLE_AP
        bool "Compile Wi-Fi SoftAP support"
        default y
        help
            Compile the SoftAP side of atomic_wifi. With this off, a_wifi_apply_mode(AP)
            returns ESP_ERR_NOT_SUPPORTED and STA becomes the only available mode.

endmenu
```

## sdkconfig.defaults
```kconfig
# Lilygo T-Display S3 -----------------------

CONFIG_LILYGO_T_DISPLAY_S3=y
CONFIG_IDF_TARGET="esp32s3"
CONFIG_IDF_TARGET_ESP32S3=y

# Flash Mode
CONFIG_ESPTOOLPY_FLASH_MODE_AUTO_DETECT=n
CONFIG_ESPTOOLPY_FLASHMODE="qio"
CONFIG_ESPTOOLPY_FLASHMODE_QIO=y
CONFIG_ESPTOOLPY_FLASHSIZE="16MB"
CONFIG_ESPTOOLPY_FLASHSIZE_16MB=y
CONFIG_ESPTOOLPY_FLASHFREQ="80m"
CONFIG_ESPTOOLPY_MONITOR_BAUD=921600

# IRAM
CONFIG_SPIRAM=y
CONFIG_SPIRAM_MODE_OCT=y
CONFIG_SPIRAM_SPEED_80M=y
CONFIG_SPIRAM_SPEED=80

# System
CONFIG_ESP_CONSOLE_USB_SERIAL_JTAG=y

# Partition
CONFIG_PARTITION_TABLE_CUSTOM=y
CONFIG_PARTITION_TABLE_CUSTOM_FILENAME="default_16MB.csv"
CONFIG_PARTITION_TABLE_FILENAME="default_16MB.csv"
CONFIG_PARTITION_TABLE_OFFSET=0x8000
CONFIG_PARTITION_TABLE_MD5=y

# All targets defaults ----------------------

# Defaults for all targets

# Flash Mode
CONFIG_ESPTOOLPY_FLASHFREQ="80m"
CONFIG_ESPTOOLPY_MONITOR_BAUD=921600
CONFIG_ESP_CONSOLE_UART_BAUDRATE=921600

# Console
CONFIG_ESP_CONSOLE_UART_CUSTOM=y
CONFIG_ESP_CONSOLE_UART=y
CONFIG_ESP_CONSOLE_UART_CUSTOM_NUM_0=y
CONFIG_ESP_CONSOLE_UART_NUM=0
CONFIG_ESP_CONSOLE_UART_BAUDRATE=921600

# Compiler
CONFIG_COMPILER_OPTIMIZATION_DEBUG=y

# Event stack
CONFIG_ESP_SYSTEM_EVENT_QUEUE_SIZE=64
CONFIG_ESP_SYSTEM_EVENT_TASK_STACK_SIZE=4096

# System
CONFIG_ESP_DEFAULT_CPU_FREQ_MHZ=240
CONFIG_ESP_DEFAULT_CPU_FREQ_MHZ_240=y

# FreeRTOS
CONFIG_FREERTOS_USE_TRACE_FACILITY=y

# Wifi
CONFIG_ESP_WIFI_ENABLE_WPA3_SAE=n
CONFIG_ESP_WIFI_ENABLE_WPA3_OWE_STA=n
CONFIG_ESP_WIFI_SOFTAP_SUPPORT=n
CONFIG_ESP_WIFI_SLP_BEACON_LOST_OPT=n
CONFIG_ESP_WIFI_ENTERPRISE_SUPPORT=n

# Bootloader
CONFIG_BOOTLOADER_LOG_LEVEL_ERROR=y
CONFIG_BOOTLOADER_LOG_LEVEL=1

# Fat
CONFIG_FATFS_LFN_HEAP=y

# Log
CONFIG_LOG_COLORS=y

# HTTP server
CONFIG_HTTPD_WS_SUPPORT=y

# LWIP
CONFIG_LWIP_MAX_SOCKETS=12
CONFIG_LWIP_DHCPS=n
CONFIG_LWIP_IPV6=n
CONFIG_LWIP_MAX_ACTIVE_TCP=8
CONFIG_LWIP_MAX_LISTENING_TCP=4

# mbedTLS
CONFIG_MBEDTLS_SSL_IN_CONTENT_LEN=4096
CONFIG_MBEDTLS_SSL_OUT_CONTENT_LEN=2048
CONFIG_MBEDTLS_CERTIFICATE_BUNDLE_DEFAULT_CMN=y
CONFIG_MBEDTLS_TLS_CLIENT_ONLY=y
CONFIG_MBEDTLS_TLS_SERVER=n
CONFIG_MBEDTLS_TLS_CLIENT=y

CONFIG_MBEDTLS_ECP_DP_SECP192K1_ENABLED=n
CONFIG_MBEDTLS_ECP_DP_SECP224K1_ENABLED=n
CONFIG_MBEDTLS_ECP_DP_SECP256K1_ENABLED=n
CONFIG_MBEDTLS_ECP_DP_BP256R1_ENABLED=n
CONFIG_MBEDTLS_ECP_DP_BP384R1_ENABLED=n
CONFIG_MBEDTLS_ECP_DP_BP512R1_ENABLED=n

# MQTT
CONFIG_MQTT_PROTOCOL_311=y
CONFIG_MQTT_PROTOCOL_5=n
CONFIG_MQTT_TRANSPORT_SSL=n
CONFIG_MQTT_TRANSPORT_WEBSOCKET=n
CONFIG_MQTT_TRANSPORT_WEBSOCKET_SECURE=n

# Websocket
CONFIG_WS_TRANSPORT=n

# LVGL
CONFIG_LV_CONF_SKIP=n
CONFIG_LV_BUILD_DEMOS=n
```
